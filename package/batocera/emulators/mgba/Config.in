## package/batocera/emulators/mgba/Config.in
```kconfig
config BR2_PACKAGE_MGBA
    select BR2_PACKAGE_SDL2
    select BR2_PACKAGE_QT5
    select BR2_PACKAGE_QT5_VERSION_LATEST
    select BR2_PACKAGE_QT5BASE
    select BR2_PACKAGE_QT5BASE_GUI
    select BR2_PACKAGE_QT5BASE_WIDGETS
    select BR2_PACKAGE_QT5BASE_OPENGL
    select BR2_PACKAGE_QT5BASE_LUA
    select BR2_PACKAGE_LIBEDIT
    bool "mGBA"
    help
      Game Boy Series Emulator
```

## package/batocera/libraries/python-i3ipc/Config.in
```kconfig
config BR2_PACKAGE_PYTHON_I3IPC
        bool "python-i3ipc"

        help
          i3ipc-python is a Python library for controlling the window manager.

          https://github.com/altdesktop/i3ipc-python
```

## package/batocera/libraries/xcb-util-xrm/Config.in
```kconfig
config BR2_PACKAGE_XCB_UTIL_XRM
	bool "xcb-util-xrm"
	select BR2_PACKAGE_LIBXCB
	select BR2_PACKAGE_XCB_UTIL
	help
	  The XCB util modules provides a number of libraries which
	  sit on top of libxcb, the core X protocol library, and some
	  of the extension libraries. These experimental libraries
	  provide convenience functions and interfaces which make the
	  raw X protocol more usable. Some of the libraries also
	  provide client-side code which is not strictly part of the X
	  protocol but which have traditionally been provided by Xlib.

	  XCB util-xrm module provides the following libraries:

	  - xrm: utility functions for the X resource manager
```

## package/batocera/utils/i3-alt-tab/Config.in
```kconfig
config BR2_PACKAGE_I3_ALT_TAB
        bool "i3-alt-tab"

        help
          alt-tab like functionality for i3

          https://github.com/yoshimoto/i3-alt-tab.py
```

## package/batocera/utils/i3-switch-if-workspace-empty/Config.in
```kconfig
config BR2_PACKAGE_I3_SWITCH_IF_WORKSPACE_EMPTY
        bool "i3-switch-if-workspace-empty"
        select BR2_PACKAGE_PYTHON_I3IPC
        select BR2_PACKAGE_PYTHON_XLIB

        help
          Python script using i3ipc to connect to i3wm: on window close,
          if the current workspace is empty, move to the first previous
          non empty workspace.
```

## package/batocera/utils/i3/Config.in
```kconfig
config BR2_PACKAGE_I3
        bool "I3"
        select BR2_PACKAGE_STARTUP_NOTIFICATION
        select BR2_PACKAGE_XCB_UTIL
        select BR2_PACKAGE_XCB_UTIL_CURSOR
        select BR2_PACKAGE_XCB_UTIL_XRM
        select BR2_PACKAGE_YAJL
        select BR2_PACKAGE_I3_ALT_TAB
        select BR2_PACKAGE_I3_SWITCH_IF_WORKSPACE_EMPTY
        select BR2_PACKAGE_XAPP_XPROP
        select BR2_PACKAGE_XAPP_XWININFO

        help
          Dynamic Window Manager

          https://github.com/i3/i3
```
